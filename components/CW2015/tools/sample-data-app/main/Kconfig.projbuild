## components/CW2015/tools/sample-data-app/main/Kconfig.projbuild
```kconfig
menu "CW2015 Sample APP Config"
    config I2C_SCL_IO
        int "GPIO number for I2C SCL"
        default 1
    config I2C_SDA_IO
        int "GPIO number for I2C SDA"
        default 2
    config END_DISCHAGE_VOLTAGE
        int "End discharge voltage (mV)"
        default 3300
endmenu
```
